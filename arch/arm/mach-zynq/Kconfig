## arch/arm/mach-zynq/Kconfig
```kconfig
if ARCH_ZYNQ

config ZYNQ_CUSTOM_INIT
	bool "Use custom ps7_init provided by Xilinx tool"
	help
	  U-Boot includes ps7_init_gpl.[ch] for some Zynq board variants.
	  If you want to override them with customized ones
	  or ps7_init code for your board is missing, please say Y here
	  and add ones into board/xilinx/zynq/custom_hw_platform/ directory.

choice
	prompt "Xilinx Zynq board select"
	default TARGET_ZYNQ_ZC702

config TARGET_ZYNQ_ZED
	bool "Zynq ZedBoard"

config TARGET_ZYNQ_MICROZED
	bool "Zynq MicroZed"

config TARGET_ZYNQ_PICOZED
	bool "Zynq PicoZed"

config TARGET_ZYNQ_ZC702
	bool "Zynq ZC702 Board"

config TARGET_ZYNQ_ZC706
	bool "Zynq ZC706 Board"

config TARGET_ZYNQ_ZC770
	bool "Zynq ZC770 Board"
	select ZYNQ_CUSTOM_INIT

config TARGET_ZYNQ_ZYBO
	bool "Zynq Zybo Board"

config TARGET_ZYNQ_DM1_G9
	bool "Zynq DragonMint T1/G9 Board"

config TARGET_ZYNQ_DM1_G19
	bool "Zynq DragonMint T1/G19 Board"

config TARGET_ZYNQ_DM1_G29
	bool "Zynq DragonMint T1/G29 Board"

config TARGET_ZYNQ_AM1_S9
	bool "Zynq AntMiner S9 Board"

config TARGET_ZYNQ_AM2_S15
	bool "Zynq Antminer S15 Board"

endchoice

config SYS_BOARD
	default "zynq"

config SYS_VENDOR
	default "xilinx"

config SYS_SOC
	default "zynq"

config SYS_CONFIG_NAME
	default "zynq_zed" if TARGET_ZYNQ_ZED
	default "zynq_microzed" if TARGET_ZYNQ_MICROZED
	default "zynq_picozed" if TARGET_ZYNQ_PICOZED
	default "zynq_zc70x" if TARGET_ZYNQ_ZC702 || TARGET_ZYNQ_ZC706
	default "zynq_zc770" if TARGET_ZYNQ_ZC770
	default "zynq_zybo" if TARGET_ZYNQ_ZYBO
	default "zynq_dm1" if TARGET_ZYNQ_DM1_G9 || TARGET_ZYNQ_DM1_G19 || TARGET_ZYNQ_DM1_G29
	default "zynq_am1" if TARGET_ZYNQ_AM1_S9
	default "zynq_am2" if TARGET_ZYNQ_AM2_S15

endif
```

## configs/zynq_am2_s15_sd_defconfig
```kconfig
CONFIG_ARM=y
CONFIG_ARCH_ZYNQ=y
CONFIG_TARGET_ZYNQ_AM2_S15=y
CONFIG_DEFAULT_DEVICE_TREE="zynq-am2-s15"
CONFIG_SPL=y
CONFIG_FIT=y
CONFIG_FIT_VERBOSE=y
CONFIG_FIT_SIGNATURE=y
CONFIG_SYS_PROMPT="Zynq> "
# CONFIG_CMD_IMLS is not set
# CONFIG_CMD_FLASH is not set
CONFIG_CMD_GPIO=y
# CONFIG_CMD_SETEXPR is not set
CONFIG_OF_EMBED=y
CONFIG_NET_RANDOM_ETHADDR=y
CONFIG_SPL_DM_SEQ_ALIAS=y
CONFIG_ZYNQ_SDHCI=y
CONFIG_NAND_ZYNQ=y
CONFIG_SPI_FLASH=y
CONFIG_SPI_FLASH_BAR=y
CONFIG_SPI_FLASH_SPANSION=y
CONFIG_SPI_FLASH_STMICRO=y
CONFIG_SPI_FLASH_WINBOND=y
CONFIG_ZYNQ_GEM=y
CONFIG_DEBUG_UART=y
CONFIG_DEBUG_UART_ZYNQ=y
CONFIG_DEBUG_UART_BASE=0xe0000000
CONFIG_DEBUG_UART_CLOCK=50000000
CONFIG_ENV_IS_NOWHERE=y
```
